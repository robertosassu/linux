## security/digest_cache/Kconfig
```kconfig
# SPDX-License-Identifier: GPL-2.0
config SECURITY_DIGEST_CACHE
	bool "Digest_cache LSM"
	select TLV_PARSER
	default n
	help
	  This option enables an LSM maintaining a cache of digests
	  (e.g. of file content or metadata).

	  This LSM can support other kernel components in making access
	  control decisions.

config DIGEST_LIST_DEFAULT_PATH
	string
	default "/etc/digest_lists"
	help
	  Default directory where digest_cache LSM expects to find digest lists.

	  It can be changed at run-time, by writing the new path to the
	  securityfs interface. Digest caches created with the old path are
	  not affected by the change.

config DIGEST_CACHE_HTABLE_DEPTH
	int
	default 30
	help
	  Desired average depth of the collision list in the digest cache
	  hash tables.

	  A smaller number will increase the amount of hash table slots, and
	  make the search faster. A bigger number will decrease the number of
	  hash table slots, but make the search slower.
```

## security/integrity/diglim/Kconfig
```kconfig
# SPDX-License-Identifier: GPL-2.0-only
# Digest Lists Integrity Module (DIGLIM)
#
config DIGLIM
	bool "Digest Lists Integrity Module (DIGLIM)"
	select SECURITYFS
	select CRYPTO
	select CRYPTO_HASH_INFO
	help
	  DIGLIM provides reference values for file content and metadata,
	  that can be used for measurement and appraisal with IMA.

config DIGLIM_DIGEST_LISTS_DIR
	string "Path of the directory containing digest lists"
	depends on DIGLIM
	default "/etc/digest_lists"
	help
	  This option defines the path of the directory containing digest lists.

config DIGLIM_UPLOADER_PATH
	string "Path of the user space digest list uploader"
	depends on DIGLIM
	default "/usr/libexec/diglim/upload_digest_lists"
	help
	  This option defines the path of the user space digest list uploader.
```

## security/testlsm/Kconfig
```kconfig
# SPDX-License-Identifier: GPL-2.0-only
config SECURITY_TESTLSM
	bool "TestLSM"
	depends on SECURITY
	help
	  This is a test LSM.
```
